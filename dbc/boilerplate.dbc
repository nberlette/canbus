VERSION "1.0.0"

CM_ "-----------------------------------------------" ;
CM_ "Boilerplate by @nberlette https://git.io/canbus" ;
CM_ "-----------------------------------------------" ;

NS_ :

BS_:

BU_: Vector__XXX

BO_ 123 MessageName: 8 Vector__XXX
 SG_ Signal001 : 0|1@1+ (1,0) [0|1] "" Vector__XXX

VAL_ 123 Signal001  0 "Disabled"  1 "Enabled" ;

CM_ BO_  123  "Message Comment" ;
CM_  SG_ 123  Signal001 "Signal Comment" ;

BA_DEF_  "ProtocolType" STRING ;
BA_DEF_DEF_  "ProtocolType" "CAN";

BA_DEF_ BO_  "VFrameFormat" ENUM  "StandardCAN","ExtendedCAN","StandardCAN_FD","ExtendedCAN_FD","J1939PG" ;
BA_DEF_DEF_  "VFrameFormat" "StandardCAN" ;
