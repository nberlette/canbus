VERSION ""

NS_ :

BS_:

BU_: Turbocharger OnBoardDataLogger Transmission2 Transmission1 Engine2 Engine1

BO_ 3221225472 VECTOR__INDEPENDENT_SIG_MSG: 0 Vector__XXX
 SG_ TrailerWeight : 0|16@1+ (2,0) [0|128510] "kg" Vector__XXX
 SG_ TireTemp : 0|16@1+ (0.03125,-273) [-273|1734.96875] "deg C" Vector__XXX
 SG_ TirePress : 0|8@1+ (4,0) [0|1000] "kPa" Vector__XXX

CM_ "(*
  NOTICE: This is a sample DBC file for educational purposes only. It is not
  intended for use in any production or commercial application. The content
  of this file is based on the J1939 DBC format, which is a standard for
  communication between electronic control units (ECUs) in heavy-duty
  vehicles. The J1939 DBC format is a proprietary standard developed by the
  Society of Automotive Engineers (SAE) and is subject to copyright and
  licensing restrictions.

  Licenses are available from the SAE directly or via authorized resellers,
  including Vector Informatik GmbH. and CSS Electronics.

  Thank you for your understanding.
  Nicholas Berlette
*)";

CM_ BO_ 3221225472 "This is a message for not used signals, created by Vector CANdb++ DBC OLE DB Provider.";
CM_ SG_ 3221225472 TireTemp "Temperature at the surface of the tire sidewall.";
CM_ SG_ 3221225472 TirePress "Pressure at which air is contained in cavity formed by tire and rim.";

BA_DEF_  "DatabaseVersion" STRING;
BA_DEF_  "BusType" STRING;
BA_DEF_  "ProtocolType" STRING;
BA_DEF_  "SAE_J1939_71_SpecVersion" STRING;
BA_DEF_  "SAE_J1939_73_SpecVersion" STRING;
BA_DEF_  "SAE_J1939_75_SpecVersion" STRING;
BA_DEF_DEF_  "SigType" "Default";
BA_DEF_DEF_  "GenSigSendType" "NoSigSendType";
BA_DEF_DEF_  "GenSigILSupport" "Yes";
BA_DEF_DEF_  "GenSigEVName" "Env@Nodename_@Signame";

BA_DEF_ BO_  "GenMsgILSupport" ENUM  "Yes","No";
BA_DEF_ BO_  "GenMsgRequestable" INT 0 1;
BA_DEF_ BO_  "GenMsgSendType" ENUM  "cyclic","reserved","cyclicIfActive","noMsgSendType";
BA_DEF_ BO_  "VFrameFormat" ENUM  "StandardCAN","ExtendedCAN","reserved","J1939PG";
BA_DEF_ BU_  "NmJ1939Function" INT 0 255;
BA_DEF_ BU_  "NmStationAddress" INT 0 255;

BA_DEF_ SG_  "SigType" ENUM  "Default","Range","RangeSigned","Control","ReferencePGN","DTC";
BA_DEF_ SG_  "GenSigSendType" ENUM  "Cyclic","OnWrite","reserved","OnChange","reserved","NoSigSendType";
BA_DEF_ SG_  "GenSigILSupport" ENUM  "Yes","No";
BA_DEF_ SG_  "GenSigEVName" STRING ;

BA_DEF_DEF_  "BusType" "";
BA_DEF_DEF_  "DatabaseVersion" "";
BA_DEF_DEF_  "GenMsgILSupport" "Yes";
BA_DEF_DEF_  "GenMsgRequestable" 1;
BA_DEF_DEF_  "GenMsgSendType" "noMsgSendType";
BA_DEF_DEF_  "NmJ1939Function" 0;
BA_DEF_DEF_  "NmStationAddress" 254;
BA_DEF_DEF_  "ProtocolType" "";
BA_DEF_DEF_  "SAE_J1939_75_SpecVersion" "";
BA_DEF_DEF_  "SAE_J1939_73_SpecVersion" "";
BA_DEF_DEF_  "SAE_J1939_71_SpecVersion" "";
BA_DEF_DEF_  "VFrameFormat" "J1939PG";

BA_ "BusType" "CAN";
BA_ "DatabaseVersion" "7.x";
BA_ "ProtocolType" "J1939";
BA_ "SAE_J1939_71_SpecVersion" "2009-09";
BA_ "SAE_J1939_73_SpecVersion" "2009-09";
BA_ "SAE_J1939_75_SpecVersion" "2005-10";

BA_ "NmJ1939Function" BU_ Turbocharger 133;
BA_ "NmStationAddress" BU_ Turbocharger 2;

BA_ "NmJ1939Function" BU_ OnBoardDataLogger 130;
BA_ "NmStationAddress" BU_ OnBoardDataLogger 251;
